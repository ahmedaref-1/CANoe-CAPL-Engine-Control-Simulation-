VERSION ""

NS_ :

BS_:

BU_: EngineControlECU AccelerationPedalECU

BO_ 939 EngineControlSpeedMessage: 1 EngineControlECU
 SG_ EngineControlSpeedValueSignal : 0|8@1+ (1,0) [0|255] "Km/h"  AccelerationPedalECU

BO_ 48 AccelerationPedalCommandMessage: 1 AccelerationPedalECU
 SG_ AccelerationPedalCommandSignal : 0|1@1+ (1,0) [0|1] ""  EngineControlECU
